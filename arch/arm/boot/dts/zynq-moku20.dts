/*
 * CAUTION: This file is automatically generated by Xilinx.
 * Version:  
 * Today is: Wed Dec  3 15:57:26 2014
*/

/dts-v1/;
/include/ "moku20-ps.dtsi"
/include/ "moku20-pl.dtsi"
/{
	chosen {
		bootargs = "console=ttyPS0,115200 root=/dev/ram rw earlyprintk vmalloc=432M";
		linux,stdout-path = &ps7_uart_1;
	} ;
	aliases {
		ethernet0 = &ps7_ethernet_0;
		i2c0 = &ps7_i2c_1;
		serial0 = &ps7_uart_1;
		serial1 = &ps7_uart_0;
		spi0 = &ps7_qspi_0;
	} ;
	ps7_ddr_0: memory@0 {
		device_type = "memory";
		reg = <0x0 0x40000000>;
	} ;
};
